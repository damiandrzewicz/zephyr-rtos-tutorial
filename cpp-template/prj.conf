## CMakeLists.txt
```
# SPDX-License-Identifier: Apache-2.0

cmake_minimum_required(VERSION 3.20.0)

set(BOARD nucleo_f446re)

find_package(Zephyr REQUIRED HINTS $ENV{ZEPHYR_BASE})
project(hello_world)

target_sources(app PRIVATE src/main.cpp)
```

## prj.conf
```kconfig
CONFIG_CPLUSPLUS=y
CONFIG_LIB_CPLUSPLUS=y
CONFIG_STD_CPP20=y
CONFIG_NEWLIB_LIBC=y
```

## src/main.cpp
```c
/*
 * Copyright (c) 2012-2014 Wind River Systems, Inc.
 *
 * SPDX-License-Identifier: Apache-2.0
 */

#include <zephyr/kernel.h>
#include <vector>
#include <string>

int main(void)
{
	printk("Hello World! %s\n", CONFIG_BOARD);

    // Range-based for loop with Initialization
	for(std::vector<int> vec {1, 2, 3, 4}; auto const &v : vec)
	{
		printk("item: %s\n", std::to_string(v).c_str());
	}
	
    // 3-way comparisons
	int a = 91, b = 110;
    auto ans1 = a <=> b;
  
    if (ans1 < 0) {
        printk("a < b");
    }
    else if (ans1 == 0) {
        printk("a == b");
    }
    else if (ans1 > 0) {
        printk("a > b");
    }
}
```
