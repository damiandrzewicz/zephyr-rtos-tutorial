/dts-v1/;
#include <st/f4/stm32f446Xe.dtsi>
#include <st/f4/stm32f446r(c-e)tx-pinctrl.dtsi>

/ {
	model = "Nucleo Board";
	compatible = "st,stm32f446re-nucleo";

	chosen {
		zephyr,sram = &sram0;
		zephyr,flash = &flash0;
	};
};

&rcc {
	clock-frequency = <DT_FREQ_M(16)>;
	ahb-prescaler = <1>;
	apb1-prescaler = <1>;
	apb2-prescaler = <1>;
};