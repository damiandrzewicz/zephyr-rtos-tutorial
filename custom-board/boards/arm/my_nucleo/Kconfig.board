## custom-board/boards/arm/my_nucleo/Kconfig.board
```kconfig
# STM32F446RE Nucleo board configuration

# Copyright (c) 2018 Philémon Jaermann
# SPDX-License-Identifier: Apache-2.0

config BOARD_MY_NUCLEO
	bool "My Nucleo Development Board"
	depends on SOC_STM32F446XX
```

## custom-board/boards/arm/my_nucleo/Kconfig.defconfig
```kconfig
# STM32F446RE Nucleo board configuration

# Copyright (c) 2018 Philémon Jaermann
# SPDX-License-Identifier: Apache-2.0

if BOARD_MY_NUCLEO

config BOARD
	default "nucleo_f446re"

endif # BOARD_NUCLEO_F446RE
```
