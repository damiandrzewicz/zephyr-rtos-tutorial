## CMakeLists.txt
```
# SPDX-License-Identifier: Apache-2.0

cmake_minimum_required(VERSION 3.20.0)

set(BOARD my_nucleo)
set(BOARD_ROOT ${CMAKE_CURRENT_SOURCE_DIR})

find_package(Zephyr REQUIRED HINTS $ENV{ZEPHYR_BASE})
project(hello_world)

target_sources(app PRIVATE src/main.cpp)
```

## prj.conf
```kconfig
CONFIG_CPLUSPLUS=y
CONFIG_LIB_CPLUSPLUS=y
CONFIG_STD_CPP20=y
CONFIG_NEWLIB_LIBC=y
```

## boards/arm/my_nucleo/my_nucleo.dts
```dts
/dts-v1/;
#include <st/f4/stm32f446Xe.dtsi>
#include <st/f4/stm32f446r(c-e)tx-pinctrl.dtsi>

/ {
	model = "Nucleo Board";
	compatible = "st,stm32f446re-nucleo";

	chosen {
		zephyr,sram = &sram0;
		zephyr,flash = &flash0;
	};
};

&rcc {
	clock-frequency = <DT_FREQ_M(16)>;
	ahb-prescaler = <1>;
	apb1-prescaler = <1>;
	apb2-prescaler = <1>;
};
```

## src/main.cpp
```c
/*
 * Copyright (c) 2012-2014 Wind River Systems, Inc.
 *
 * SPDX-License-Identifier: Apache-2.0
 */

#include <zephyr/kernel.h>
//#include <zephyr/drivers/gpio.h>

// #define SLEEP_TIME_MS   1000

// #define MY_GPIOS_NODE DT_NODELABEL(green_led_2)

// static const struct gpio_dt_spec led = GPIO_DT_SPEC_GET(MY_GPIOS_NODE, gpios);

int main(void)
{
    // int ret;

	// if (!device_is_ready(led.port)) {
	// 	return 0;
	// }

	// ret = gpio_pin_configure_dt(&led, GPIO_OUTPUT_ACTIVE);
	// if (ret < 0) {
	// 	return 0;
	// }

    // while (1) {
	// 	ret = gpio_pin_toggle_dt(&led);
	// 	if (ret < 0) {
	// 		return 0;
	// 	}

	// 	k_msleep(SLEEP_TIME_MS);
	// }
}
```
